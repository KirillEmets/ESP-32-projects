#include "driver/display.h"

#include <string.h>
#include "i2c_connection.h"

#define CONTROL_COMMAND 0x00
#define CONTROL_DATA    0x40

#define FONT_FIRST_CHAR 0x20
#define FONT_LAST_CHAR  0x7E
#define FONT_WIDTH      5

static i2c_device_t s_dev;
static uint8_t s_framebuffer[DISPLAY_WIDTH * DISPLAY_LINES];

// Classic 5x7 ASCII font, column-major, LSB at the top
static const uint8_t s_font[][FONT_WIDTH] = {
    {0x00, 0x00, 0x00, 0x00, 0x00}, // ' '
    {0x00, 0x00, 0x5F, 0x00, 0x00}, // !
    {0x00, 0x07, 0x00, 0x07, 0x00}, // "
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    {0x10, 0x08, 0x08, 0x10, 0x08}, // ~
};

static esp_err_t send_commands(const uint8_t *cmds, size_t len)
{
    return i2c_connection_write_reg(s_dev, CONTROL_COMMAND, cmds, len);
}

esp_err_t display_init(void)
{
    esp_err_t err = i2c_connection_add_device(DISPLAY_I2C_ADDRESS, 400000, &s_dev);
    if (err != ESP_OK) {
        return err;
    }

    static const uint8_t init_sequence[] = {
        0xAE,             // display off
        0xD5, 0x80,       // clock divide ratio / oscillator
        0xA8, 0x3F,       // multiplex ratio: 64 rows
        0xD3, 0x00,       // display offset: 0
        0x40,             // start line: 0
        0x8D, 0x14,       // charge pump on
        0x20, 0x00,       // horizontal addressing mode
        0xA1,             // segment remap (column 127 -> SEG0)
        0xC8,             // COM scan direction: remapped
        0xDA, 0x12,       // COM pins config for 128x64
        0x81, 0xCF,       // contrast
        0xD9, 0xF1,       // pre-charge period
        0xDB, 0x40,       // VCOMH deselect level
        0xA4,             // output follows RAM
        0xA6,             // normal (non-inverted)
        0xAF,             // display on
    };

    err = send_commands(init_sequence, sizeof(init_sequence));
    if (err != ESP_OK) {
        return err;
    }

    display_clear();
    return display_update();
}

void display_clear(void)
{
    memset(s_framebuffer, 0, sizeof(s_framebuffer));
}

void display_draw_text(uint8_t line, uint8_t x, const char *text)
{
    if (line >= DISPLAY_LINES) {
        return;
    }

    uint8_t *row = &s_framebuffer[line * DISPLAY_WIDTH];

    for (; *text != '\0'; text++) {
        char c = *text;
        if (c < FONT_FIRST_CHAR || c > FONT_LAST_CHAR) {
            c = '?';
        }

        const uint8_t *glyph = s_font[c - FONT_FIRST_CHAR];
        for (int col = 0; col < FONT_WIDTH; col++) {
            if (x >= DISPLAY_WIDTH) {
                return;
            }
            row[x++] = glyph[col];
        }

        // 1 px spacing between characters
        if (x >= DISPLAY_WIDTH) {
            return;
        }
        row[x++] = 0x00;
    }
}

esp_err_t display_update(void)
{
    static const uint8_t window[] = {
        0x21, 0x00, DISPLAY_WIDTH - 1,  // column range
        0x22, 0x00, DISPLAY_LINES - 1,  // page range
    };

    esp_err_t err = send_commands(window, sizeof(window));
    if (err != ESP_OK) {
        return err;
    }

    return i2c_connection_write_reg(s_dev, CONTROL_DATA, s_framebuffer, sizeof(s_framebuffer));
}
